## firmware/esp32-dw3220/sdkconfig.defaults
```kconfig
# ESP32-S3 DW3220 UWB Accessory - SDK Configuration Defaults

# Target ESP32-S3
CONFIG_IDF_TARGET="esp32s3"

# Bluetooth
CONFIG_BT_ENABLED=y
CONFIG_BT_NIMBLE_ENABLED=y
CONFIG_BT_NIMBLE_MAX_CONNECTIONS=3
CONFIG_BT_NIMBLE_GAP_DEVICE_NAME_MAX_LEN=32

# SPI Master
CONFIG_SPI_MASTER_IN_IRAM=y

# FreeRTOS
CONFIG_FREERTOS_HZ=1000
CONFIG_FREERTOS_UNICORE=n

# Log Level
CONFIG_LOG_DEFAULT_LEVEL_INFO=y
CONFIG_LOG_MAXIMUM_LEVEL_DEBUG=y

# Flash
CONFIG_ESPTOOLPY_FLASHSIZE_4MB=y
CONFIG_PARTITION_TABLE_CUSTOM=y
CONFIG_PARTITION_TABLE_CUSTOM_FILENAME="partitions.csv"

# Power Management
CONFIG_PM_ENABLE=y
```
